## Documentation/devicetree/bindings/media/i2c/st,vd55g0.yaml
```yaml
# SPDX-License-Identifier: (GPL-2.0 OR BSD-2-Clause)
# Copyright (c) 2026 STMicroelectronics SA.
%YAML 1.2
---
$id: http://devicetree.org/schemas/media/i2c/st,vd55g0.yaml#
$schema: http://devicetree.org/meta-schemas/core.yaml#

title: STMicroelectronics VD55G0 Global Shutter Image Sensor

maintainers:
  - Benjamin Mugnier <benjamin.mugnier@foss.st.com>
  - Sylvain Petinot <sylvain.petinot@foss.st.com>

description: |-
 The STMicroelectronics VD55G0 is a monochrome global shutter image sensor
 with an active array size of 644H x 604V. It is programmable through an I2C
 interface.

 Image data is sent through MIPI CSI-2, over a single data lane. The sensor
 provides 4 GPIOs, which can drive a strobe light source synchronised with the
 exposure period.

allOf:
  - $ref: /schemas/media/video-interface-devices.yaml#

properties:
  compatible:
    const: st,vd55g0

  reg:
    maxItems: 1

  clocks:
    maxItems: 1

  vcore-supply:
    description: Digital core power supply (1.2V)

  vddio-supply:
    description: Digital IO power supply (1.8V)

  vana-supply:
    description: Analog power supply (2.8V)

  reset-gpios:
    description: Sensor reset active low GPIO (XSHUTDOWN)
    maxItems: 1

  st,leds:
    description:
      List of sensor GPIOs used to control strobe light sources during the
      exposure time. The numbers identify the sensor pin on which the
      illumination system is connected. GPIOs are active-high.
    $ref: /schemas/types.yaml#/definitions/uint32-array
    minItems: 1
    maxItems: 4
    items:
      minimum: 0
      maximum: 3

  port:
    $ref: /schemas/graph.yaml#/$defs/port-base
    additionalProperties: false

    properties:
      endpoint:
        $ref: /schemas/media/video-interfaces.yaml#
        unevaluatedProperties: false

        properties:
          data-lanes:
            items:
              - const: 1

          link-frequencies:
            maxItems: 1
            items:
              minimum: 375000000
              maximum: 600000000
            description:
              The MIPI output runs at twice the link frequency, 750 to 1200
              Mbps, and at an integer multiple of the input clock frequency.

          lane-polarities:
            minItems: 1
            maxItems: 2

        required:
          - data-lanes
          - link-frequencies

required:
  - compatible
  - reg
  - clocks
  - vcore-supply
  - vddio-supply
  - vana-supply
  - reset-gpios
  - port

unevaluatedProperties: false

examples:
  - |
    #include <dt-bindings/gpio/gpio.h>
    #include <dt-bindings/media/video-interface-devices.h>

    i2c {
        #address-cells = <1>;
        #size-cells = <0>;

        camera-sensor@60 {
            compatible = "st,vd55g0";
            reg = <0x60>;

            clocks = <&camera_clk_12M>;

            vcore-supply = <&camera_vcore_v1v2>;
            vddio-supply = <&camera_vddio_v1v8>;
            vana-supply = <&camera_vana_v2v8>;

            reset-gpios = <&gpio 5 GPIO_ACTIVE_LOW>;
            st,leds = <1>;

            orientation = <MEDIA_ORIENTATION_FRONT>;
            rotation = <0>;

            port {
                endpoint {
                    data-lanes = <1>;
                    link-frequencies = /bits/ 64 <402000000>;
                    remote-endpoint = <&csiphy0_ep>;
                };
            };
        };
    };
```
